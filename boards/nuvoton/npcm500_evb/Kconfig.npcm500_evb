## boards/nuvoton/npcm500_evb/Kconfig.npcm500_evb
```kconfig
# Copyright (c) 2024 Nuvoton Technology Corporation.
# SPDX-License-Identifier: Apache-2.0

config BOARD_NPCM500_EVB
	bool "Nuvoton NPCM500 EVB Development board"
	select SOC_NPCM500
```

## boards/nuvoton/npcm500_evb/board.yml
```yaml
board:
  name: npcm500_evb
  vendor: nuvoton
  revision:
    format: custom
  socs:
  - name: npcm500
```

## boards/nuvoton/npcm500_evb/npcm500_evb_defconfig
```kconfig
#
# Copyright (c) 2024 Nuvoton Technology Corporation.
#
# SPDX-License-Identifier: Apache-2.0
#

CONFIG_SRAM_VECTOR_TABLE=y
CONFIG_BOOTLOADER_SRAM_SIZE=0
# General Kernel Options
CONFIG_SYS_CLOCK_HW_CYCLES_PER_SEC=96000000
CONFIG_XIP=n

CONFIG_FPU=y
# CONFIG_ARM_MPU=y
# CONFIG_NPCM_ITIM_SYSTICK=y

# Clock Driver
CONFIG_CLOCK_CONTROL=y

# Pinctrl Driver
CONFIG_PINCTRL=y

# UART Driver
CONFIG_SERIAL=y
CONFIG_UART_INTERRUPT_DRIVEN=y
CONFIG_UART_SHELL=y
CONFIG_UART_USE_RUNTIME_CONFIGURE=y

# Console Driver
CONFIG_CONSOLE=y
CONFIG_UART_CONSOLE=y

# GPIO Driver
CONFIG_GPIO=y
CONFIG_GPIO_SHELL=y

# SGPIO Driver
CONFIG_SGPIO_NPCM=y

# Flash Driver
CONFIG_FLASH=y
CONFIG_FLASH_SHELL=y

# SPI Driver
CONFIG_SPI=y
CONFIG_SPI_SHELL=y

# Watchdog Driver
CONFIG_WATCHDOG=y

# ADC Driver
CONFIG_ADC=y

# I2C Driver
CONFIG_I2C=y

# USBD Driver
CONFIG_USB_DEVICE_DRIVER=y

# Networking config
CONFIG_NETWORKING=y
CONFIG_NET_L2_ETHERNET=y
CONFIG_NET_IPV4=y
CONFIG_NET_IPV6=n
CONFIG_NET_TCP=y
CONFIG_NET_SOCKETS=y
CONFIG_POSIX_API=y
CONFIG_NET_SHELL=y

# Network driver config
CONFIG_TEST_RANDOM_GENERATOR=y

# Counter Driver
CONFIG_COUNTER=y
CONFIG_COUNTER_SHELL=y

# TACH Driver
CONFIG_SENSOR=y

# PWM Driver
CONFIG_PWM=y
CONFIG_PWM_SHELL=y

# PWM LED Driver
CONFIG_LED=y
CONFIG_LED_SHELL=y

#I3C Driver
CONFIG_I3C=y
CONFIG_I3C_USE_IBI=y
CONFIG_I3C_SHELL=y

# C2H Driver
CONFIG_C2H_NPCM=y

# RTC Driver
CONFIG_RTC=y
CONFIG_RTC_ALARM=y
CONFIG_RTC_NPCM=y

# eSPI Driver
CONFIG_ESPI=y
CONFIG_ESPI_NPCM=y
CONFIG_ESPI_TAF_NPCM=y
CONFIG_ESPI_NPCM_FLASH_SAFS_HW_MODE=y

# IPMI Driver
CONFIG_IPMI=y
CONFIG_IPMI_KCS_NPCM=y

# HWINFO Driver
CONFIG_HWINFO=y

# fs
CONFIG_FILE_SYSTEM=y
CONFIG_SHELL_BACKEND_SERIAL_RX_RING_BUFFER_SIZE=128
CONFIG_FILE_SYSTEM_LITTLEFS=y
CONFIG_FLASH_MAP=y
```

## drivers/adc/Kconfig.npcm
```kconfig
# NPCM ADC driver configuration options

# Copyright (c) 2024 Nuvoton Technology Corporation.
# SPDX-License-Identifier: Apache-2.0

config ADC_NPCM
	bool "Nuvoton NPCM ADC driver"
	default y
	depends on DT_HAS_NUVOTON_NPCM_ADC_ENABLED
	help
	  This option enables the ADC driver for NPCM family of
	  processors.
	  Say y if you wish to use ADC channels on NPCM MCU.

config ADC_NPCM_SARADC
        bool "Nuvoton NPCM5 SARADC driver"
        default n
        depends on DT_HAS_NUVOTON_NPCM_SAR_ADC_ENABLED
        help
          This option enables the SARADC driver for NPCM family of
          processors.
          Say y if you wish to use SARADC channels on NPCM MCU.

if ADC_NPCM_SARADC

config ADC_V2T_NPCM
        bool "NPCM5 SARADC voltage-to-temperature conversion"
        default n
        help
          Enable the voltage-to-temperature (V2T) conversion feature of
          the NPCM5 SAR ADC. Allows reading thermistor temperature via
          TCHNnDAT registers (CC0-CC7 channels only).

config ADC_CMP_NPCM
        bool "NPCM5 SARADC threshold comparator / event detection"
        default n
        help
          Enable threshold event detection using the three independent
          threshold detectors (THRCTLm, THR_DCTLm). Provides single and
          dual hysteresis threshold modes with optional k_work callback.

if ADC_CMP_NPCM

config ADC_CMP_NPCM_WORKQUEUE
        bool "NPCM5 SARADC threshold detection dedicated work queue"
        help
          Use a dedicated work queue (instead of the system work queue)
          for threshold event callback delivery.

if ADC_CMP_NPCM_WORKQUEUE

config ADC_CMP_NPCM_WORKQUEUE_PRIORITY
        int "NPCM5 SARADC threshold work queue priority"
        default SYSTEM_WORKQUEUE_PRIORITY
        help
          Priority for the dedicated ADC threshold detection work queue.

config ADC_CMP_NPCM_WORKQUEUE_STACK_SIZE
        int "NPCM5 SARADC threshold work queue stack size"
        default 768
        help
          Stack size in bytes for the dedicated ADC threshold detection
          work queue.

endif # ADC_CMP_NPCM_WORKQUEUE

endif # ADC_CMP_NPCM

endif # ADC_NPCM_SARADC
```

## drivers/clock_control/Kconfig.npcm
```kconfig
# NPCM Clock controller driver configuration options

# Copyright (c) 2024 Nuvoton Technology Corporation.
# SPDX-License-Identifier: Apache-2.0

config CLOCK_CONTROL_NPCM
	bool "NPCM clock controller driver"
	default y
	depends on DT_HAS_NUVOTON_NPCM_PCC_ENABLED
	help
	  Enable support for NPCM clock controller driver.

config CLOCK_CONTROL_NPCM_FPGA
	bool "FPGA mode - bypass PLL configuration"
	depends on CLOCK_CONTROL_NPCM
	help
	  Enable this option when running on FPGA where clocks are fixed
	  and PLL configuration should be bypassed. The clock controller
	  will skip PLL and prescaler configuration, assuming the FPGA
	  provides a fixed clock.
```

## drivers/crypto/Kconfig.npcm
```kconfig
# NPCM SHA driver configuration options

# Copyright (c) 2022 Nuvoton Technology Corporation.
# SPDX-License-Identifier: Apache-2.0

config CRYPTO_NPCM_SHA
	bool "NPCM SHA driver"
	default y
	depends on DT_HAS_NUVOTON_NPCM_SHA_ENABLED
	help
	  Enable NPCM SHA driver.
```

## drivers/dma/Kconfig.npcm_pdma
```kconfig
# Nuvoton PDMA Driver Configuration Options

# Copyright (c) 2025 Nuvoton Corporation
# SPDX-License-Identifier: Apache-2.0

config DMA_NPCM_PDMA
	bool "Nuvoton NPCM PDMA Driver"
	depends on DT_HAS_NUVOTON_NPCM_PDMA_ENABLED
	default y
	help
	  Enable Nuvoton NPCM Direct Memory Access (PDMA) driver.
```

## drivers/espi/Kconfig.npcm
```kconfig
# NPCM eSPI driver configuration options

# Copyright (c) 2020 Nuvoton Technology Corporation.
# SPDX-License-Identifier: Apache-2.0

config ESPI_NPCM
	bool "Nuvoton NPCM embedded controller (EC) ESPI driver"
	default y
	depends on SOC_FAMILY_NPCM
	depends on DT_HAS_NUVOTON_NPCM_ESPI_ENABLED
	help
	  This option enables the Intel Enhanced Serial Peripheral Interface
	  (eSPI) for NPCM family of processors.

config ESPI_NPCM_PERIPHERAL_ACPI_SHD_MEM_SIZE
	int "Host I/O peripheral port size for shared memory in npcm series"
	depends on ESPI_NPCM || ESPI_PERIPHERAL_ACPI_SHM_REGION
	default 256
	help
	  This is the port size used by the Host and EC to communicate over
	  the shared memory region to return the ACPI response data. Please
	  notice the valid value in npcm ec series for this option is 8/16/32/
	  64/128/256/512/1024/2048/4096 bytes.

config ESPI_NPCM_PERIPHERAL_HOST_CMD_PARAM_SIZE
	int "Host I/O peripheral port size for ec host command in npcm series"
	depends on ESPI_NPCM || ESPI_PERIPHERAL_EC_HOST_CMD
	default 256
	help
	  This is the port size used by the Host and EC to communicate over
	  the shared memory region to return the host command parameter data.
	  Please notice the valid value in npcm ec series for this option is
	  8/16/32/64/128/256/512/1024/2048/4096 bytes.

config ESPI_NPCM_PERIPHERAL_DEBUG_PORT_80_MULTI_BYTE
	bool "Host can write 1/2/4 bytes of Port80 data in a eSPI transaction"
	depends on (SOC_SERIES_NPCM5 || SOC_SERIES_NPCM4) && ESPI_PERIPHERAL_DEBUG_PORT_80
	help
	  EC can accept 1/2/4 bytes of Port 80 data written from the Host in an
	  eSPI transaction.

config ESPI_NPCM_PERIPHERAL_DEBUG_PORT_80_RING_BUF_SIZE
	int "Debug Port80 ring buffer size"
	depends on ESPI_NPCM_PERIPHERAL_DEBUG_PORT_80_MULTI_BYTE
	default 256
	help
	  The size of the ring buffer in byte used by the Port80 ISR to store
	  Postcodes from Host.

config ESPI_TAF_NPCM
	bool "Nuvoton NPCM embedded controller (EC) ESPI TAF driver"
	depends on SOC_SERIES_NPCM5 || SOC_SERIES_NPCM4
	depends on FLASH
	help
	  This option enables the Intel Enhanced Serial Peripheral Interface
	  Target Attached Flash (eSPI TAF) for NPCM family of processors.

config ESPI_TAF_PR_NUM
	int "Sets of protection region settings"
	default 16
	help
	  This size is display how many group of slave attached flash protection
	  region.

config ESPI_NPCM_FLASH_SAFS_HW_MODE
	bool "ESPI FLASH SAFS hardware mode"
	default n
	help
	  Enable hardware-based Serial Advanced Flash Storage (SAFS) mode for the
	  eSPI flash channel in the NPCM series. This mode provides enhanced
	  performance for flash communication over the eSPI interface.

# The default value 'y' for the existing options if ESPI_NPCM is selected.
if ESPI_NPCM

config ESPI_FLASH_CHANNEL
	default y

config ESPI_OOB_CHANNEL
	default y

config ESPI_PERIPHERAL_8042_KBC
	default n

config ESPI_PERIPHERAL_HOST_IO
	default y

config ESPI_PERIPHERAL_DEBUG_PORT_80
	default n

config ESPI_PERIPHERAL_EC_HOST_CMD
	default y

config ESPI_PERIPHERAL_ACPI_SHM_REGION
	default y

config ESPI_PERIPHERAL_CUSTOM_OPCODE
	default n

config ESPI_PERIPHERAL_PMCH3
	bool "NPCM PMCH3 Support"
	default y
	help
	  Enables PM channel 3 for eSPI peripheral channel.

config ESPI_PERIPHERAL_PMCH4
	bool "NPCM PMCH4 Support"
	default y
	help
	  Enables PM channel 4 for eSPI peripheral channel.

config ESPI_PERIPHERAL_SHM_MBI
	bool "NPCM SHM and Mailbox Support"
	default n
	help
	  Enable SHM and Mailbox for eSPI peripheral channel.

config ESPI_NPCM_SUPP_VW_GPIO
	bool "Indicates that the eSPI hardware supports virtual wire GPIOs"
	default n if SOC_SERIES_NPCM5 || SOC_SERIES_NPCM4
	help
	  Selected if NPCM series supports virtual wire GPIOs in eSPI module.

config ESPI_RTC_SUPP
	bool
	default n

endif #ESPI_NPCM
```

## drivers/gpio/Kconfig.npcm
```kconfig
# NPCX GPIO driver configuration options

# Copyright (c) 2024 Nuvoton Technology Corporation.
# SPDX-License-Identifier: Apache-2.0

config GPIO_NPCM
	bool "Nuvoton NPCM enhance Super I/O (eSIO) gpio driver"
	default y
	depends on DT_HAS_NUVOTON_NPCM_GPIO_ENABLED
	help
	  This option enables the GPIO driver for NPCM family of
	  processors.
	  Say y if you wish to use serial port on NPCM MCU.

config SGPIO_NPCM
	bool "Nuvoton NPCM sgpio driver"
	depends on SOC_FAMILY_NPCM
	help
	  This option enables the SGPIO driver for NPCM family of
	  processors.
	  Say y if you wish to use SGPIO on NPCM MCU.

config GPIO_NPCM_SGPIO_INIT_PRIORITY
	int "Init priority"
	depends on SGPIO_NPCM
	default 60
	help
	  Device driver initialization priority.
```

## drivers/gpio/Kconfig.npcm_vw
```kconfig
# NPCM eSPI Virtual Wire GPIO driver configuration options

# Copyright (c) 2023 Nuvoton Technology Corporation.
# SPDX-License-Identifier: Apache-2.0

config GPIO_NPCM_VW
	bool "Nuvoton NPCM eSPI Virtual Wire GPIO driver"
	default y
	depends on SOC_FAMILY_NPCM
	depends on ESPI
	depends on DT_HAS_NUVOTON_NPCM_VW_GPIO_ENABLED
	help
	  This option enables the eSPI Virtual Wire GPIO driver for the
	  NPCM family of processors. Virtual Wire GPIOs are mapped through
	  the eSPI virtual wire channel (VWGPSM/VWGPMS registers).
	  Say y if you wish to use Virtual Wire GPIO on an NPCM MCU.

config GPIO_NPCM_VW_INIT_PRIORITY
	int "NPCM Virtual Wire GPIO init priority"
	depends on GPIO_NPCM_VW
	default 61
	help
	  Device driver initialization priority for Virtual Wire GPIO.
	  Must be initialized after the eSPI controller.
```

## drivers/i2c/Kconfig.npcm
```kconfig
# NPCM I2C driver configuration options

# Copyright (c) 2024 Nuvoton Technology Corporation.
# SPDX-License-Identifier: Apache-2.0

config I2C_NPCM
	bool "Nuvoton NPCM I2C driver"
	default y
	depends on DT_HAS_NUVOTON_NPCM_I2C_ENABLED
	help
	  This option enables the I2C driver for NPCM family of
	  processors.
	  Say y to use I2C modules on NPCM MCU.

config CONTROLLER_HW_TIMEOUT_EN
	bool "Controller hardware timeout"
	default n
	help
	  Arm the SCL low and START-to-STOP timeout detectors for the
	  duration of each controller transfer. When one expires the module
	  is reset to release the bus and the transfer fails with -ETIMEDOUT.
	  Ignored when TARGET_HW_TIMEOUT_EN is set, which keeps the detectors
	  armed all the time.

config CONTROLLER_HW_TIMEOUT_CLK_CYCLE_TIME
	depends on CONTROLLER_HW_TIMEOUT_EN
	int "Controller hardware timeout clock cycle time"
	default 50
	range 0 255
	help
	  Longest time from START to STOP, in milliseconds.

config CONTROLLER_HW_TIMEOUT_CLK_LOW_TIME
	depends on CONTROLLER_HW_TIMEOUT_EN
	int "Controller hardware timeout clock low time"
	default 25
	range 0 255
	help
	  Longest cumulative time SCL may be held low within one
	  transaction, in milliseconds (SMBus tTIMEOUT is 25-35 ms).

config TARGET_HW_TIMEOUT_EN
	bool "Target hardware timeout"
	default n
	help
	  Keep the SCL low and START-to-STOP timeout detectors armed while
	  the module is enabled. When one expires the module is reset, which
	  releases a bus held by this module (for example SCL stretched
	  while an interrupt is never serviced) and drops the transaction.
	  Note that when using Quick command (SMBUS), do not enable target timeout.

config TARGET_HW_TIMEOUT_CLK_LOW_TIME
	depends on TARGET_HW_TIMEOUT_EN
	int "Target hardware timeout clock low time"
	default 25
	range 0 255
	help
	  Longest cumulative time SCL may be held low within one
	  transaction, in milliseconds (SMBus tTIMEOUT is 25-35 ms).

config TARGET_HW_TIMEOUT_CLK_CYCLE_TIME
	depends on TARGET_HW_TIMEOUT_EN
	int "Target hardware timeout clock cycle time"
	default 50
	range 0 255
	help
	  Longest time from START to STOP, in milliseconds.
```

## drivers/ipmi/Kconfig.npcm
```kconfig
# Nuvoton IPMI driver configuration options

# Copyright (c) 2021 Nuvoton Technology Corporation.
# SPDX-License-Identifier: Apache-2.0

config IPMI_KCS_NPCM
	bool "NPCM IPMI KCS driver"
	depends on SOC_FAMILY_NPCM
	help
	  This option enables the KCS BMC driver for NPCM SoCs.
	  Say y if you wish to use KCS channels on NPCM MCU.
```

## drivers/jtag/Kconfig.npcm
```kconfig
# NPCM4XX JTAG driver configuration options

# Copyright (c) 2023 Nuvoton Technology Inc.
# SPDX-License-Identifier: Apache-2.0

config JTAG_NPCM
	bool "NPCM JTAG driver"
	depends on SOC_FAMILY_NPCM
	help
	  This option enables the JTAG driver for NPCM family of
	  processors.
	  Say y if you wish to use JTAG channels on NPCM MCU.
```
