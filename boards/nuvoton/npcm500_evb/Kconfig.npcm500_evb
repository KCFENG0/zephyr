## drivers/mbox/Kconfig.npcm_caliptra_mci
```kconfig
# Copyright (c) 2026 Nuvoton Technology Corporation
# SPDX-License-Identifier: Apache-2.0

config MBOX_NPCM_CALIPTRA_MCI
	bool "Nuvoton NPCM Caliptra MCU_MBOX driver"
	default y
	depends on DT_HAS_NUVOTON_NPCM_CALIPTRA_MCI_MBOX_ENABLED
	help
	  M7-side driver for the Caliptra MCU_MBOX hardware mailbox.

if MBOX_NPCM_CALIPTRA_MCI

choice MBOX_NPCM_CALIPTRA_MCI_NOTIFY
	prompt "MCU_MBOX notification source"
	default MBOX_NPCM_CALIPTRA_MCI_POLL

config MBOX_NPCM_CALIPTRA_MCI_POLL
	bool "Polling"
	help
	  A driver thread polls EXECUTE / CMD_STATUS. Use until the M7
	  mailbox interrupt has been verified.

config MBOX_NPCM_CALIPTRA_MCI_IRQ
	bool "Interrupt"
	help
	  Use the hardware interrupt. Requires a valid interrupts property
	  in devicetree.

endchoice

config MBOX_NPCM_CALIPTRA_MCI_POLL_THREAD_STACK_SIZE
	int "Poll thread stack size"
	default 768
	depends on MBOX_NPCM_CALIPTRA_MCI_POLL

config MBOX_NPCM_CALIPTRA_MCI_POLL_THREAD_PRIO
	int "Poll thread priority"
	default 7
	depends on MBOX_NPCM_CALIPTRA_MCI_POLL

config MBOX_NPCM_CALIPTRA_MCI_BUSID
	hex "M7 SOC AXI USER (written to MCI BUSID_CTL0 at init)"
	default 0x1
	help
	  AXI USER value the M7 advertises to the Caliptra MCI bus. Must match
	  one of the slots the MCU ROM provisioned via configure_mcu_mbox_axi_users();
	  otherwise mailbox CSR/SRAM writes from the M7 are silently filtered.

config MBOX_NPCM_CALIPTRA_MCI_FORCE_TARGET_USER
	bool "Force TARGET_USER / TARGET_USER_VALID writes on requester send"
	default n
	help
	  FPGA bring-up quirk workaround. Per spec the SOC Sender -> MCU flow
	  does not require setting TARGET_USER/VALID, but earlier FPGA images
	  needed it to wake the MCU's CMD_AVAIL handler. Enable only if you
	  see the requester block forever in CMD_STATUS polling.

endif # MBOX_NPCM_CALIPTRA_MCI
```

## drivers/misc/c2h_npcm/Kconfig
```kconfig
# NPCM misc. driver options

# Copyright (c) 2024 Nuvoton
# SPDX-License-Identifier: Apache-2.0


config C2H_SHELL
	bool "C2H Shell commands"
	depends on SHELL
	help
	  C2H Shell commands

config C2H_NPCM
	bool "NPCM core access to host modules driver"
	depends on DT_HAS_NUVOTON_NPCM_C2H_ENABLED
	help
	  This option enables the c2h driver for NPCM
	  SoCs.
	  Say y if you wish to access host modules
	  on NPCM SMC.
```

## drivers/misc/shm_npcm/Kconfig
```kconfig
# NPCM misc. driver options

# Copyright (c) 2024 Nuvoton
# SPDX-License-Identifier: Apache-2.0

config SHM_NPCM
	bool "NPCM host modules share memory driver"
	depends on SOC_FAMILY_NPCM
	help
	  This option enables the host module share memory driver
	  for NPCM SoCs.
	  Say y if you wish to access host modules
	  on NPCM SMC.
```

## drivers/otp/Kconfig.npcm
```kconfig
# Nuvoton NPCM OTP driver options

# Copyright (c) 2026 Nuvoton Technology Corporation.
# SPDX-License-Identifier: Apache-2.0

config OTP_NPCM
	bool "Nuvoton NPCM OTP memory driver"
	default y
	depends on DT_HAS_NUVOTON_NPCM_OTP_ENABLED
	depends on CLOCK_CONTROL
	help
	  Enable the driver for the Nuvoton NPCM one-time-programmable memory
	  controller. It can read the fuse array, program it when
	  CONFIG_OTP_PROGRAM is set, and apply region write or read/write
	  protection.

if OTP_NPCM

config OTP_NPCM_READ_TIMEOUT_US
	int "Nuvoton NPCM OTP read timeout (us)"
	default 1000
	help
	  How long to wait for the controller to report read-done, and for it to
	  power down after an operation.

	  The datasheet specifies no read access time, so this is a generous
	  bound rather than a measured one. Lower it once real timings are
	  known.

config OTP_NPCM_PROGRAM_TIMEOUT_MS
	int "Nuvoton NPCM OTP program timeout (ms)"
	default 50
	depends on OTP_PROGRAM
	help
	  How long to wait for the controller to report program-done for a
	  single bit.

	  The datasheet specifies no program pulse time. Programming is
	  charge-pump driven and this path already runs in thread context, so
	  the default errs well on the generous side.

	  The driver polls between sleeps, so the effective poll interval is at
	  least one system tick. On a low SYS_CLOCK_TICKS_PER_SEC this budget
	  buys proportionally fewer polls; raise it if the tick period
	  approaches the timeout.

config OTP_NPCM_UNLOCK_ON_INIT
	bool "Clear OTP region locks during initialization"
	help
	  Make the first write to both OTP lock registers after a Core Domain
	  reset zero, clearing all region locks.

	  Enable only for bring-up or test firmware. This overrides the boot
	  owner's lock policy and must not be enabled in production firmware.

config OTP_NPCM_INIT_TIMEOUT_US
	int "Nuvoton NPCM OTP init timeout (us)"
	default 1000
	help
	  How long to wait at init for the controller to finish reading its
	  initial security region. The datasheet specifies no bound for this.

endif # OTP_NPCM
```

## drivers/spi/Kconfig.npcm
```kconfig
# Nuvoton NPCM SPI Driver configuration options

# Copyright (c) 2024 Nuvoton Technology Corporation.
# SPDX-License-Identifier: Apache-2.0

config SPI_NPCM_SPIP
	bool "Nuvoton NPCM Enhanced Super I/O (eSIO) SPI driver"
	default y
	depends on DT_HAS_NUVOTON_NPCM_SPIP_ENABLED
	help
	  Enable the SPI peripherals on NPCM MCU.

config SPIP_NPCM_INTERRUPT
	bool "NPCM SPIP Interrupt Support"
	depends on SPI_NPCM_SPIP
	help
	  Enable Interrupt support for the SPI Driver of NPCM chip.

config SPI_NPCM_USE_RUNTIME_CONFIGURE
	bool "Runtime configuration for NPCM SPIP peripherals"
	default n
	help
	  Enable runtime configuration of NPCM SPIP peripherals.
	  This disables applications to call spi_context_configured() to
	  configure the NPCM SPI peripherals at runtime. If this is
	  disabled, NPCM SPIP peripherals rely on SPI driver's
	  initialization function to properly configure
	  the controller.
```

## drivers/watchdog/Kconfig.npcm
```kconfig
# NPCM WDT driver configuration options

# Copyright (c) 2024 Nuvoton Technology Corporation.
# SPDX-License-Identifier: Apache-2.0

config WDT_NPCM
	bool "Nuvoton NPCM Watchdog Timer driver"
	default y
	depends on DT_HAS_NUVOTON_NPCM_WATCHDOG_ENABLED
	select HAS_WDT_DISABLE_AT_BOOT
	help
	  This option enables the Watchdog Timer driver for the Nuvoton NPCM
	  family of processors.

config WDT_NPCM_WARNING_LEADING_TIME_MS
	int "Milliseconds before generating watchdog reset"
	depends on WDT_NPCM
	default 500
	help
	  When a timeout callback is installed, this option defines the window
	  between the watchdog event (callback) and the SoC reset. The window
	  is rounded up to the watchdog clock period of the selected timeout
	  range.
```

## dts/bindings/adc/nuvoton,npcm-sar-adc.yaml
```yaml
# Copyright (c) 2024 Nuvoton Technology Corporation.
# SPDX-License-Identifier: Apache-2.0

description: Nuvoton, NPCM5 SAR ADC node

compatible: "nuvoton,npcm-sar-adc"

include: [adc-controller.yaml, pinctrl-device.yaml]

properties:
  reg:
    required: true

  interrupts:
    required: true

  clocks:
    required: true

  pinctrl-0:
    required: false

  pinctrl-names:
    required: false

  vref-mv:
    type: int
    required: true
    description: ADC reference voltage (Unit:mV)

  channel-count:
    type: int
    required: true
    description: the number of ADC channels

  threshold-count:
    type: int
    required: true
    description: the number of threshold detectors

  resolution-bits:
    type: int
    description: ADC resolution in bits

io-channel-cells:
  - channel
```

## dts/bindings/crypto/nuvoton,npcm-sha.yaml
```yaml
# Copyright (c) 2022 Nuvoton Technology Corporation.
# SPDX-License-Identifier: Apache-2.0

description: NPCM Crypto SHA accelerator.

compatible: "nuvoton,npcm-sha"

include: base.yaml

properties:
  reg:
    required: true

  in-swap:
    type: boolean
    description: SHA input data swap

  out-swap:
    type: boolean
    description: SHA output data swap
```

## dts/bindings/dma/nuvoton,npcm-pdma.yaml
```yaml
# Copyright 2025 Nuvoton
# SPDX-License-Identifier: Apache-2.0

description: |
  NPCM PDMA Controller

  A phandle to the DMA controller plus "channel" integer cell specifying
  channel to be used for data transfer

  Example for npcm PDMA Controller
     pdma: pdma@40015000 {
                  compatible = "nuvoton,npcm-pdma";
                  ...
                  dma-channels = <14>;
                  #dma-cells = <2>;
            };

  If SPIP uses channel 0 for Tx DMA and channel 1 for Rx DMA
     spip1: spi@40016000 {
                  compatible = "nuvoton,npcm-spip";
                  ...
                  dmas = <&pdma 0 NPCM_PDMA_SRC_CH_SPI1_TX>, <&pdma 1 NPCM_PDMA_SRC_CH_SPI1_RX>;
                  dma-names = "tx", "rx";
            };
compatible: "nuvoton,npcm-pdma"

include: dma-controller.yaml

properties:
  reg:
    required: true
  "#dma-cells":
    const: 2

# Parameter syntax
dma-cells:
  - channel
  - perid
```

## dts/bindings/gpio/nuvoton,npcm-sgpio.yaml
```yaml
# Copyright (c) 2023 Nuvoton Technology Corporation.
# SPDX-License-Identifier: Apache-2.0


description: Nuvoton, NPCM-SGPIO node

compatible: "nuvoton,npcm-sgpio"

include: [base.yaml, pinctrl-device.yaml]

properties:
  reg:
    required: true

  pinctrl-0:
    required: true

  pinctrl-names:
    required: true

  nuvoton,bus-freq:
    type: int
    default: 8000000
    description:
      SGPIO clock frequency.

  nuvoton,input-ngpios:
    type: int
    required: true

  nuvoton,output-ngpios:
    type: int
    required: true

child-binding:
  description: GPIO child node
  include: gpio-controller.yaml
  properties:
    ngpios:
      required: true

    pin-offset:
      type: int
      required: true
      description: Pin offset of this GPIO entry

    "#gpio-cells":
      const: 2

  gpio-cells:
  - pin
  - flags
```

## dts/bindings/gpio/nuvoton,npcm-vw-gpio.yaml
```yaml
# Copyright (c) 2023 Nuvoton Technology Corporation.
# SPDX-License-Identifier: Apache-2.0

description: |
  Nuvoton NPCM eSPI Virtual Wire GPIO controller.

  This node is the parent controller covering the full VW GPIO register range.
  Child nodes (no compatible needed) each represent one 32-bit bank register
  controlling 4 wires:
    Bits [3:0]  = Wire 3-0 data
    Bits [7:4]  = Wire 3-0 Valid (set when writing to VWGPSM)

  Register address is computed by the driver as:
    parent_base + bank_idx * 4

  VWGPSM (Slave-to-Master, output, BIC->Host): set nuvoton,vw-is-output
  VWGPMS (Master-to-Slave, input,  Host->BIC): omit nuvoton,vw-is-output

compatible: "nuvoton,npcm-vw-gpio"

include: [base.yaml]

properties:
  reg:
    type: array
    required: true
    description: Base address and total size covering all SM and MS bank registers.

child-binding:
  description: |
    One VW GPIO bank register (4 wires). Child nodes of nuvoton,npcm-vw-gpio
    do not need a compatible property; their binding is inherited from here.

  include: [gpio-controller.yaml]

  properties:
    label:
      type: string
      description: |
        Device name used by device_get_binding(), e.g. "VWGPSM0" / "VWGPMS15".

    nuvoton,vw-is-output:
      type: boolean
      description: |
        Present when this bank is a VWGPSM (Slave-to-Master, output) register.
        Absent for VWGPMS (Master-to-Slave, input) registers.

    nuvoton,vw-bank-index:
      type: int
      required: true
      description: |
        Global bank index 0~31.
        0~15  = VWGPSM0~15 (Slave-to-Master, output, BIC->Host).
        16~31 = VWGPMS0~15 (Master-to-Slave, input,  Host->BIC).
        Register address = parent_base + bank_idx * 4.
```

## dts/bindings/i3c/snps,designware-i3c.yaml
```yaml
# Copyright (C) 2020 Samsung Electronics Co., Ltd.
# Copyright (C) 2023 Meta Platforms
# SPDX-License-Identifier: Apache-2.0

description: >
    This is a binding for the Synopsys I3C interface

compatible: "snps,designware-i3c"

include: [i3c-controller.yaml, pinctrl-device.yaml]

properties:
  clocks:
    required: true

  od-thigh-max-ns:
    type: int
    default: 41
    description: |
      Maximum high clock pulse length (ns) in Open-Drain mode.
      The default is value from Section 6.2 of the I3C
      Specifiction.

  od-tlow-min-ns:
    type: int
    default: 200
    description: |
      Minimum low clock pulse length (ns) in Open-Drain mode.
      The default is value from Section 6.2 of the I3C
      Specifiction.

  pp-thigh-max-ns:
    type: int
    default: 45
    description: |
      Maximum high clock pulse length (ns) in Push-Pull mode.
      The default is value from Section 6.2 of the I3C
      Specifiction.

  pp-tlow-min-ns:
    type: int
    description: |
      Minimum low clock pulse length (ns) in Push-Pull mode.

  sda-tx-hold-ns:
    type: int
    default: 10
    description: |
      The hold time of the SDA with respect to the SCL edge.
      The unit is in nanosecond.

  pec-en:
    type: boolean
    description: |
      Enable the use of Packet Error Code (PEC) in I3C transfers.
      If set to true, the driver will expect and handle PEC bytes
      in I3C messages.
```
