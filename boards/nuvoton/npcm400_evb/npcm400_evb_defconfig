## boards/nuvoton/npcm400_evb/npcm400_evb_defconfig
```kconfig
# Copyright (c) 2024 Nuvoton Technology Corporation.
#
# SPDX-License-Identifier: Apache-2.0

CONFIG_SRAM_VECTOR_TABLE=y

# General Kernel Options
CONFIG_SYS_CLOCK_HW_CYCLES_PER_SEC=96000000
CONFIG_XIP=y

# Pinctrl Driver
CONFIG_PINCTRL=y

# UART Driver
CONFIG_SERIAL=y
CONFIG_UART_INTERRUPT_DRIVEN=y

# Console Driver
CONFIG_CONSOLE=y
CONFIG_UART_CONSOLE=y

# GPIO Driver
CONFIG_GPIO=y
```

## dts/bindings/gpio/nuvoton,npcm-gpio.yaml
```yaml
# Copyright (c) 2024 Nuvoton Technology Corporation.
# SPDX-License-Identifier: Apache-2.0

description: Nuvoton, NPCM-GPIO node

compatible: "nuvoton,npcm-gpio"

include: [gpio-controller.yaml, base.yaml]

properties:
  reg:
    required: true

  ngpios:
    description: number of pins for gpio entry

  index:
    type: int
    required: true
    description: index of gpio device

  "#gpio-cells":
    const: 2

gpio-cells:
  - pin
  - flags
```

## dts/bindings/pinctrl/nuvoton,npcm-pinctrl-def.yaml
```yaml
# Copyright (c) 2024 Nuvoton Technology Corporation.
# SPDX-License-Identifier: Apache-2.0

description: Nuvoton, NPCM Default Pins Configurations

compatible: "nuvoton,npcm-pinctrl-def"

include: [base.yaml]

properties:
  def-gpio-list:
    type: phandles
    required: true
    description: list of configurations of pinmux controllers need to set
```

## dts/bindings/pinctrl/nuvoton,npcm-pinctrl.yaml
```yaml
# Copyright (c) 2024 Nuvoton Technology Corporation.
# SPDX-License-Identifier: Apache-2.0

description: |
  The Nuvoton pin controller is a singleton node responsible for controlling
  pin function selection and pin properties. For example, you can use these
  nodes to select peripheral pin functions.

  Here is a list of supported standard pin properties:
    - bias-pull-down: Enable pull-down resistor.
    - bias-pull-up: Enable pull-up resistor.

  Custom pin properties for npcm series are available also:
    - pinmux-gpio: Inverse pinmux back to gpio

  An example for NPCM4 family, include the chip level pinctrl DTSI file in the
  board level DTS:

    #include <nuvoton/npcm/npcm4/npcm4-pinctrl.dtsi>

  We want to use the I2C0_0 port of the NPCM400F controller and enable the
  internal 3.3V pull-up if its i2c frequency won't exceed 400kHz.

  To change a pin's pinctrl default properties, add a reference to the pin in
  the board's DTS file and set the properties in child node of pinctrl as below:

    i2c1a_scl_sda_gpio60_61: periph-i2c1a {
      pupd {
        bias-pull-up; /* Enable internal pull-up for i2c0_0 */
        periph-pupd = <NPCM_PINCTRL_DEVPU0_0_SMB1A_PUE>; /* Pull-up config for i2c0_0 */
      };
      scl {
        pinmux = <GPIO60__RSTOUT2__SCL1A 2>;
      };
      sda {
        pinmux = <GPIO61__RSTOUT1__SDA1A 2>;
      };
    };

    &i2c0_0 {
      pinctrl-0 = <&i2c1a_scl_sda_gpio60_61>;
      pinctrl-names = "default";
    }

compatible: "nuvoton,npcm-pinctrl"

include: base.yaml

properties:
  reg:
    required: true

child-binding:
  description: |
    NPCM pin controller pin configuration nodes.
  child-binding:
    description: |
      NPCM pin controller pin configuration group.

    include:
      - name: pincfg-node.yaml
        property-allowlist:
          - bias-pull-down
          - bias-pull-up

    properties:
      pinmux:
        type: array
        description: Configurations of alt pin selection.
      dev-ctl:
        type: array
        description: Configurations of device control such as tri-state, io type and so on.
      periph-pupd:
        type: array
        description: |
          A map to PUPD_ENn register/bit that enable pull-up/down of NPCM peripheral devices.
          Please don't overwrite this property in the board-level DT driver.
```

## dts/bindings/pinctrl/nuvoton,npcm-scfg.yaml
```yaml
# Copyright (c) 2024 Nuvoton Technology Corporation.
# SPDX-License-Identifier: Apache-2.0

description: Nuvoton, NPCM System Configuration (Pinmux, 1.8V support and so on) node

compatible: "nuvoton,npcm-scfg"

include: [base.yaml]

properties:
  reg:
    required: true
```
