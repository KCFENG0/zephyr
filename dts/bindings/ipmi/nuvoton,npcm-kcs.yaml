## dts/bindings/ipmi/nuvoton,npcm-kcs.yaml
```yaml
# Copyright (c) 2021, Nuvoton Technology Corporation.
# SPDX-License-Identifier: Apache-2.0

description: Nuvoton NPCM IPMI KCS

compatible: "nuvoton,npcm-kcs"

include: ipmi-controller.yaml

properties:
    chan:
      type: int
      required: true
      description: KCS channel number

    addr:
      type: int
      required: true
      description: KCS I/O port address
```

## dts/bindings/jtag/nuvoton,npcm-jtag.yaml
```yaml
# Copyright (c) 2023 Nuvoton Technology Corporation.
# SPDX-License-Identifier: Apache-2.0

description: Nuvoton NPCM JTAG Master controller

compatible: "nuvoton,npcm-jtag"

include: [base.yaml, pinctrl-device.yaml]

properties:
  reg:
    required: true

  interrupts:
    required: true

  clocks:
    required: true
```

## dts/bindings/mbox/nuvoton,npcm-caliptra-mci-mbox.yaml
```yaml
# Copyright (c) 2026 Nuvoton Technology Corporation
# SPDX-License-Identifier: Apache-2.0

description: |
  Nuvoton NPCM M7-side view of a Caliptra MCU_MBOX instance.
  Each node exposes two mbox channels: channel 0 = requester, channel 1 = responder.

compatible: "nuvoton,npcm-caliptra-mci-mbox"

include: [base.yaml, mailbox-controller.yaml]

properties:
  reg:
    required: true
    description: Two tuples - SRAM aperture then CSR control page.

  reg-names:
    required: true
    description: Must be ["sram", "csr"].

  interrupts:
    required: false
    description: |
      soc_mcu_mbox*_data_avail (EXECUTE && MBOX_USER == MCU), level-high.
      Required when MBOX_NPCM_CALIPTRA_MCI_IRQ is selected.

  sram-size:
    type: int
    required: true
    description: Usable mailbox SRAM in bytes (aperture is 0x200000).

  poll-interval-ms:
    type: int
    default: 5
    description: |
      Poll-mode cadence in milliseconds. In IRQ mode, the cadence for
      watching requester completion and responder close, which raise no
      M7 interrupt.

  "#mbox-cells":
    const: 1

mbox-cells:
  - channel
```

## dts/bindings/otp/nuvoton,npcm-otp.yaml
```yaml
# Copyright (c) 2026 Nuvoton Technology Corporation.
# SPDX-License-Identifier: Apache-2.0

description: |
  Nuvoton NPCM One-Time-Programmable (OTP) memory controller.

  The OTP array is a fuse array: bits only ever transition from 0 to 1, and a
  programmed bit can never be cleared. Region write- and read-protection is
  applied through the OTP_LOCK/OTP_LOCK2 registers, which are sticky until a
  Core Domain reset rather than fused, so protection must be re-applied on
  every boot.

  The controller has no power-down control bit, so the clocks phandle exists
  only so the driver can obtain the APB1 rate needed to program the OTP clock
  divider (OTP_CLK must be approximately 1 MHz). clock_control_on() is never
  called on it.

compatible: "nuvoton,npcm-otp"

include: [base.yaml]

properties:
  reg:
    required: true

  clocks:
    required: true

  size:
    type: int
    default: 1024
    description: |
      Number of OTP array bytes the driver may address. OTP_ADDR is ten bits
      wide, so the build rejects a value above 1024.
```

## soc/nuvoton/npcm/npcm4/Kconfig
```kconfig
# Nuvoton Cortex-M4 Embedded Controller NPCM4 series

# Copyright (c) 2024 Nuvoton Technology Corporation.
# SPDX-License-Identifier: Apache-2.0

config SOC_SERIES_NPCM4
	select ARM
	select CPU_CORTEX_M4
	select CPU_CORTEX_M_HAS_DWT
	select SOC_FAMILY_NPCM
	select CPU_HAS_ARM_MPU
	help
	  Enable support for Nuvoton NPCM4 series

config FLASH_SIZE
	int "Flash Size in kB"
	default $(dt_chosen_reg_size_int,$(DT_CHOSEN_Z_FLASH),0,K) if !XIP
	help
	  This option specifies the size of the flash in kB.  It is normally set by
	  the board's defconfig file and the user should generally avoid modifying
	  it via the menu configuration.

config FLASH_BASE_ADDRESS
	hex "Flash Base Address"
	default $(dt_chosen_reg_addr_hex,$(DT_CHOSEN_Z_FLASH)) if !XIP
	help
	  This option specifies the base address of the flash on the board. It is
	  normally set by the board's defconfig file and the user should generally
	  avoid modifying it via the menu configuration.
```

## soc/nuvoton/npcm/npcm5/Kconfig
```kconfig
# Nuvoton Cortex-M7 Embedded Controller NPCM5 series

# Copyright (c) 2024 Nuvoton Technology Corporation.
# SPDX-License-Identifier: Apache-2.0

config SOC_SERIES_NPCM5
	select ARM
	select CPU_CORTEX_M7
	select CPU_CORTEX_M_HAS_DWT
	select SOC_FAMILY_NPCM
	select CPU_HAS_ARM_MPU
	select CPU_HAS_CUSTOM_FIXED_SOC_MPU_REGIONS
	select CPU_HAS_FPU
	select CPU_HAS_ICACHE
	select CPU_HAS_DCACHE
	select CLOCK_CONTROL
	select SOC_RESET_HOOK
	select SOC_LATE_INIT_HOOK
	help
	  Enable support for Nuvoton NPCM5 series

config FLASH_SIZE
	int "Flash Size in kB"
	default $(dt_chosen_reg_size_int,$(DT_CHOSEN_Z_FLASH),0,K) if !XIP
	help
	  This option specifies the size of the flash in kB.  It is normally set by
	  the board's defconfig file and the user should generally avoid modifying
	  it via the menu configuration.

config FLASH_BASE_ADDRESS
	hex "Flash Base Address"
	default $(dt_chosen_reg_addr_hex,$(DT_CHOSEN_Z_FLASH)) if !XIP
	help
	  This option specifies the base address of the flash on the board. It is
	  normally set by the board's defconfig file and the user should generally
	  avoid modifying it via the menu configuration.

choice GPIO_NPCM_RESET_SL
	prompt "Selects the GPIO reset to the corresponding reset source"
	default GPIO_NPCM_RESET_SL_CORE_DOMAIN

config GPIO_NPCM_RESET_SL_CORE_DOMAIN
	bool "GPIO Reset by Core domain reset"
	help
	  GPIO port 0-9, A-F is reset by Core domain reset.

config GPIO_NPCM_RESET_SL_POWER_UP
	bool "GPIO Reset by VSB Power-Up reset"
	help
	GPIO port 0-9, A-F is reset by VSB Power-Up reset.
endchoice

# The chip revision comes from the board revision (-b npcm500_evb@a2), not a
# prompt: the devicetree is built before Kconfig and differs per revision too,
# so a second switch here could disagree with it.
config NPCM500_REV_A2
	def_bool "$(BOARD_REVISION)" = "a2"
	depends on SOC_SERIES_NPCM5
	help
	  Revision in development, FPGA only for now. Its MCU ROM parses only
	  v3 flash images and boots only through Caliptra. Whether the target
	  is the FPGA is separate: CONFIG_NPCM500_FPGA.

config NPCM500_REV_A1
	def_bool !NPCM500_REV_A2
	depends on SOC_SERIES_NPCM5
	help
	  Taped-out revision, on the EVB and on the FPGA. Its MCU ROM parses
	  v1 flash images and boots in bypass or Caliptra mode.

config PLATFORM_SPECIFIC_INIT
	default n if SOC_SERIES_NPCM5
	help
	  Disable deprecated PLATFORM_SPECIFIC_INIT for NPCM5 as it uses SOC_RESET_HOOK instead.

config SOC_NPCM5_HYPERRAM_MPU_DEVICE
	bool "Map HyperRAM (0x90000000) as Device Shareable in MPU"
	depends on SOC_SERIES_NPCM5
	default n
	help
	  When enabled, the FIU1 DRA HyperRAM window (0x90000000-0x9FFFFFFF)
	  is mapped as Device Shareable (TEX=0, C=0, B=1, S=1) in the MPU.

	  Without this, the CM7 write buffer may issue 32-bit volatile stores
	  as narrow (AWSIZE=2) AXI SINGLE beats. The FIU DRA slave rejects
	  sub-bus-width SINGLE transactions with SLVERR, causing a BUS FAULT
	  on any isolated 32-bit write.

	  Device Shareable forces each store to be a non-bufferable, strongly-
	  ordered AXI transaction at full 64-bit bus width (AWSIZE=3) with
	  WSTRB byte enables, which the FIU DRA accepts.

	  Note: This is a workaround for FPGA validation. Whether silicon
	  requires this mapping depends on the final FIU DRA AXI slave design.
```

## soc/nuvoton/npcm/npcm5/Kconfig.defconfig
```kconfig
# Nuvoton Cortex-M4 Embedded Controller

# Copyright (c) 2024 Nuvoton Technology Corporation.
# SPDX-License-Identifier: Apache-2.0

if SOC_SERIES_NPCM5

config NUM_IRQS
	default 82

config CORTEX_M_SYSTICK
	default !NPCM_ITIM_SYSTICK

DT_CHOSEN_Z_FLASH := zephyr,flash

config ROM_START_OFFSET
	default 0x600 if XIP
	default 0x0   if !XIP

endif # SOC_SERIES_NPCM5
```

## soc/nuvoton/npcm/npcm5/Kconfig.soc
```kconfig
# Nuvoton Cortex-M4 Embedded Controller NPCM5 series

# Copyright (c) 2024 Nuvoton Technology Corporation.
# SPDX-License-Identifier: Apache-2.0

config SOC_SERIES_NPCM5
	bool
	select SOC_FAMILY_NPCM
	help
	  Enable support for Nuvoton NPCM5 series

config SOC_NPCM500
	bool
	select SOC_SERIES_NPCM5
	help
	  NPCM500

config SOC_SERIES
	default "npcm5" if SOC_SERIES_NPCM5

config SOC
	default "npcm500" if SOC_NPCM500
```

## subsys/usb/device/class/Kconfig.obmf
```kconfig
# Copyright (c) 2025 Google LLC
# SPDX-License-Identifier: Apache-2.0

menuconfig USB_DEVICE_OBMF
	bool "USB OCP OBMF Class support"
	help
	  USB OCP OBMF device class support.

if USB_DEVICE_OBMF

config USB_OBMF_DEVICE_NAME
	string "USB OBMF device name template"
	default "OBMF"
	help
	  Device name template for the OBMF Devices. First device would have
	  name $(USB_OBMF_DEVICE_NAME)_0, etc.

module = USB_OBMF
default-count = 1
source "subsys/usb/device/class/Kconfig.template.composite_device_number"

config OBMF_BULK_EP_MPS
	int "OBMF bulk endpoint size"
	default 512 if USB_DC_HAS_HS_SUPPORT
	default 64
	help
	  OBMF class bulk endpoints size.

config OBMF_INTERRUPT_IN_EP_SUPPORT
	bool "Enable OBMF Interrupt IN endpoint"
	default y
	help
	  Enable support for the optional Interrupt IN endpoint
	  (Device -> Host notification/event).

config OBMF_INTERRUPT_IN_EP_MPS
	int "OBMF Interrupt IN endpoint size"
	default 16
	depends on OBMF_INTERRUPT_IN_EP_SUPPORT
	help
	  OBMF class Interrupt IN endpoint max packet size.
	  Recommended <= 64 bytes.

config OBMF_INTERRUPT_OUT_EP_SUPPORT
	bool "Enable OBMF Interrupt OUT endpoint"
	default n
	help
	  Enable support for the optional Interrupt OUT endpoint
	  (Host -> Device notification/event).

config OBMF_INTERRUPT_OUT_EP_MPS
	int "OBMF Interrupt OUT endpoint size"
	default 16
	depends on OBMF_INTERRUPT_OUT_EP_SUPPORT
	help
	  OBMF class Interrupt OUT endpoint max packet size.
	  Recommended <= 64 bytes.

module = USB_OBMF
module-str = usb obmf
source "subsys/logging/Kconfig.template.log_config"

endif # USB_DEVICE_OBMF
```

## tests/drivers/flash/npcm_nor/testcase.yaml
```yaml
common:
  tags:
    - drivers
    - flash
  harness: ztest
tests:
  drivers.flash.npcm_nor:
    platform_allow:
      - npcm400_evb
      - npcm500_evb
```

## tests/drivers/mbox/npcm_caliptra_mci/testcase.yaml
```yaml
common:
  tags: drivers mbox
tests:
  drivers.mbox.npcm_caliptra_mci.proto:
    platform_allow:
      - native_sim
      - native_sim/native/64
```
